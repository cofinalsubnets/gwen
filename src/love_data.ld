/* love_data.ld -- generated by mx.l. do not edit; edit the table there.
   the data sentinels' tiling for the host link (love.c's DSENT, love.h's
   ai_typ). INSERT augments the default script instead of replacing it, so this
   drops onto a host link as a plain -T fragment. the output name leads with a
   dot, so it is no C identifier and ld defines no bounds for it -- the two
   symbols here are the ASSERT's. holo needs no script at all: it lays each
   section on the grain the object declares, which is this same tiling. */
SECTIONS {
  .love.data : ALIGN(16) {
    __start_love_data = .;
    KEEP(*(love.data.0))  . = __start_love_data + 16;
    KEEP(*(love.data.1))  . = __start_love_data + 32;
    KEEP(*(love.data.2))  . = __start_love_data + 48;
    KEEP(*(love.data.3))  . = __start_love_data + 64;
    KEEP(*(love.data.4))  . = __start_love_data + 80;
    KEEP(*(love.data.5))  . = __start_love_data + 96;
    KEEP(*(love.data.6))  . = __start_love_data + 112;
    KEEP(*(love.data.7))  . = __start_love_data + 128;
    KEEP(*(love.data.8))  . = __start_love_data + 144;
    __stop_love_data = .;
  }
} INSERT AFTER .text;
ASSERT(__stop_love_data - __start_love_data == 9 * 16,
       "love_data: slot count moved -- sync love.h's ai_data_n and mx.l")
